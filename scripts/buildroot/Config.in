## scripts/buildroot/ext_monitor_defconfig
```kconfig
# Buildroot Configuration for Raspberry Pi Zero Minimal Appliance
BR2_arm=y
BR2_arm1176jzf_s=y
BR2_TOOLCHAIN_BUILDROOT_GLIBC=y
BR2_TARGET_GENERIC_HOSTNAME="pi0-monitor"
BR2_TARGET_GENERIC_ISSUE="Welcome to Raspberry Pi Zero Extended Display Appliance"
BR2_TARGET_GENERIC_GETTY_PORT="ttyAMA0"
# BR2_TARGET_GENERIC_REMOUNT_ROOTFS_RW is not set

BR2_ROOTFS_OVERLAY="$(BR2_EXTERNAL_EXT_MONITOR_PATH)/rootfs-overlay"
BR2_ROOTFS_POST_IMAGE_SCRIPT="$(BR2_EXTERNAL_EXT_MONITOR_PATH)/board/post-image.sh"

BR2_LINUX_KERNEL=y
BR2_LINUX_KERNEL_DEFCONFIG="bcmrpi"
BR2_LINUX_KERNEL_DTS_SUPPORT=y
BR2_LINUX_KERNEL_INTREE_DTS_NAME="bcm2708-rpi-zero"
BR2_LINUX_KERNEL_NEEDS_HOST_OPENSSL=y

BR2_PACKAGE_RPI_FIRMWARE=y
BR2_PACKAGE_RPI_FIRMWARE_BOOTCODE_BIN=y
BR2_PACKAGE_KMOD=y
BR2_PACKAGE_UTIL_LINUX=y

BR2_TARGET_ROOTFS_INITRAMFS=y
# BR2_TARGET_ROOTFS_TAR is not set

BR2_PACKAGE_HOST_DOSFSTOOLS=y
BR2_PACKAGE_HOST_GENIMAGE=y
BR2_PACKAGE_HOST_MTOOLS=y
```
